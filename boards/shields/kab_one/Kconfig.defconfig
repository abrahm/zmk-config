## boards/shields/kab_one/Kconfig.defconfig
```kconfig
if SHIELD_KAB_ONE_LEFT

config ZMK_KEYBOARD_NAME
    default "kab-one"

config ZMK_SPLIT_ROLE_CENTRAL
    default y

endif # SHIELD_KAB_ONE_LEFT

if SHIELD_KAB_ONE_LEFT || SHIELD_KAB_ONE_RIGHT

config ZMK_SPLIT
    default y

endif # SHIELD_KAB_ONE_LEFT || SHIELD_KAB_ONE_RIGHT
```

## boards/shields/kab_one/Kconfig.shield
```kconfig
config SHIELD_KAB_ONE_LEFT
    def_bool $(shields_list_contains,kab_one_left)

config SHIELD_KAB_ONE_RIGHT
    def_bool $(shields_list_contains,kab_one_right)

config SHIELD_KAB_ONE_DONGLE
    def_bool $(shields_list_contains,kab_one_dongle)
```
